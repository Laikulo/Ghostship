## os/ghostship/Config.in
```kconfig
source "$BR2_EXTERNAL_ghostship_PATH/package/python-klipper/Config.in"
source "$BR2_EXTERNAL_ghostship_PATH/package/moonraker/Config.in"

# Generated below here
source "$BR2_EXTERNAL_ghostship_PATH/package/python-smart-open/Config.in"
source "$BR2_EXTERNAL_ghostship_PATH/package/python-streaming-form-data/Config.in"
source "$BR2_EXTERNAL_ghostship_PATH/package/python-preprocess-cancellation/Config.in"
source "$BR2_EXTERNAL_ghostship_PATH/package/python-msgspec/Config.in"
source "$BR2_EXTERNAL_ghostship_PATH/package/python-inotifysimple/Config.in"
source "$BR2_EXTERNAL_ghostship_PATH/package/python-enum34-ghostship/Config.in"
source "$BR2_EXTERNAL_ghostship_PATH/package/python-libnacl/Config.in"
source "$BR2_EXTERNAL_ghostship_PATH/package/python-poetry-core/Config.in"
```

## os/ghostship/configs/ghostship_qemu_x64_defconfig
```kconfig
BR2_x86_64=y
BR2_TOOLCHAIN_BUILDROOT_MUSL=y
BR2_TOOLCHAIN_BUILDROOT_CXX=y
BR2_GLOBAL_PATCH_DIR="board/qemu/patches"
BR2_DOWNLOAD_FORCE_CHECK_HASHES=y
BR2_TARGET_GENERIC_ROOT_PASSWD="ghostship"
# BR2_TARGET_GENERIC_GETTY is not set
BR2_SYSTEM_DHCP="eth0"
BR2_ROOTFS_POST_BUILD_SCRIPT="board/qemu/x86_64/post-build.sh"
BR2_ROOTFS_POST_IMAGE_SCRIPT="board/qemu/post-image.sh"
BR2_ROOTFS_POST_SCRIPT_ARGS="$(BR2_DEFCONFIG)"
BR2_LINUX_KERNEL=y
BR2_LINUX_KERNEL_LATEST_CIP_VERSION=y
BR2_LINUX_KERNEL_USE_CUSTOM_CONFIG=y
BR2_LINUX_KERNEL_CUSTOM_CONFIG_FILE="board/qemu/x86_64/linux.config"
BR2_LINUX_KERNEL_ZSTD=y
BR2_LINUX_KERNEL_NEEDS_HOST_OPENSSL=y
BR2_LINUX_KERNEL_NEEDS_HOST_LIBELF=y
BR2_PACKAGE_LINUX_TOOLS_CPUPOWER=y
BR2_PACKAGE_LINUX_TOOLS_GPIO=y
BR2_PACKAGE_LINUX_TOOLS_PCI=y
BR2_PACKAGE_PYTHON3=y
BR2_PACKAGE_PYTHON3_BZIP2=y
BR2_PACKAGE_PYTHON3_CURSES=y
BR2_PACKAGE_PYTHON3_READLINE=y
BR2_PACKAGE_PYTHON3_XZ=y
BR2_PACKAGE_CA_CERTIFICATES=y
BR2_PACKAGE_LIBPCAP=y
BR2_PACKAGE_DROPBEAR=y
BR2_PACKAGE_GESFTPSERVER=y
BR2_PACKAGE_IPROUTE2=y
BR2_TARGET_ROOTFS_CPIO_ZSTD=y
BR2_TARGET_ROOTFS_INITRAMFS=y
# BR2_TARGET_ROOTFS_TAR is not set
BR2_PACKAGE_HOST_E2FSPROGS=y
BR2_PACKAGE_HOST_QEMU=y
BR2_PACKAGE_HOST_QEMU_SYSTEM_MODE=y
BR2_PACKAGE_PYTHON_KLIPPER=y
BR2_PACKAGE_MOONRAKER=y
```

## os/ghostship/package/moonraker/Config.in
```kconfig
config BR2_PACKAGE_MOONRAKER
	bool "moonraker"
	select BR2_PACKAGE_PYTHON_TORNADO
	select BR2_PACKAGE_PYTHON_SERIAL
	select BR2_PACKAGE_PYTHON_SERIAL_ASYNCIO
	select BR2_PACKAGE_PYTHON_PILLOW
	select BR2_PACKAGE_PYTHON_LMDB
	select BR2_PACKAGE_PYTHON_DISTRO
	select BR2_PACKAGE_PYTHON_INOTIFYSIMPLE
	select BR2_PACKAGE_PYTHON_PYNACL
	select BR2_PACKAGE_PYTHON_PAHO_MQTT
	select BR2_PACKAGE_PYTHON_ZEROCONF
	select BR2_PACKAGE_PYTHON_JINJA2
	select BR2_PACKAGE_PYTHON_UVLOOP
	select BR2_PACKAGE_PYTHON_STREAMING_FORM_DATA
	select BR2_PACKAGE_PYTHON_PREPROCESS_CANCELLATION
	select BR2_PACKAGE_PYTHON_MSGSPEC
	select BR2_PACKAGE_PYTHON_DBUS_NEXT
# TODO: apprise
# TODO: ldap3
	help
	  Klipper API Server
```

## os/ghostship/package/python-enum34-ghostship/Config.in
```kconfig
config BR2_PACKAGE_PYTHON_ENUM34_GHOSTSHIP
	bool "python-enum34-ghostship"
	help
	  Python 3.4 Enum backported to 3.3, 3.2, 3.1, 2.7, 2.6, 2.5,
	  and 2.4.

	  https://bitbucket.org/stoneleaf/enum34
```

## os/ghostship/package/python-inotifysimple/Config.in
```kconfig
config BR2_PACKAGE_PYTHON_INOTIFYSIMPLE
	bool "python-inotifysimple"
	# select BR2_PACKAGE_PYTHON_ENUM34 # runtime
	help
	  A simple wrapper around inotify. No fancy bells and
	  whistles, just a literal wrapper with ctypes. Under 100
	  lines of code!.

	  https://github.com/chrisjbillington/inotify_simple
```

## os/ghostship/package/python-klipper/Config.in
```kconfig
config BR2_PACKAGE_PYTHON_KLIPPER
	bool "python-klipper"
        select BR2_PACKAGE_PYTHON_CFFI
        select BR2_PACKAGE_PYTHON_GREENLET
        select BR2_PACKAGE_PYTHON_SERIAL
        select BR2_PACKAGE_PYTHON_JINJA2
        select BR2_PACKAGE_PYTHON_CAN
	select BR2_PACKAGE_PYTHON_MARKUPSAFE 
        select BR2_PACKAGE_LIBUSB
        select BR2_PACKAGE_LIBUSB_COMPAT
	help
	  Klipper host daemon
```

## os/ghostship/package/python-msgspec/Config.in
```kconfig
config BR2_PACKAGE_PYTHON_MSGSPEC
	bool "python-msgspec"
	help
	  A fast serialization and validation library, with builtin
	  support for JSON, MessagePack, YAML, and TOML.

	  https://jcristharif.com/msgspec/
```

## os/ghostship/package/python-poetry-core/Config.in
```kconfig
config BR2_PACKAGE_PYTHON_POETRY_CORE
	bool "python-poetry-core"
	help
	  poetry core
```

## os/ghostship/package/python-preprocess-cancellation/Config.in
```kconfig
config BR2_PACKAGE_PYTHON_PREPROCESS_CANCELLATION
	bool "python-preprocess-cancellation"
	help
	  GCode processor to add klipper cancel-object markers.

	  https://github.com/kageurufu/cancelobject-preprocessor
```

## os/ghostship/package/python-streaming-form-data/Config.in
```kconfig
config BR2_PACKAGE_PYTHON_STREAMING_FORM_DATA
	bool "python-streaming-form-data"
	select BR2_PACKAGE_PYTHON_SMART_OPEN # runtime
	help
	  Streaming parser for multipart/form-data.

	  https://github.com/siddhantgoel/streaming-form-data
```
